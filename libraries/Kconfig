## libraries/Kconfig
```kconfig
config SOC_FAMILY_STM32
    bool
    
config SOC_SERIES_STM32F4
    bool
    select ARCH_ARM_CORTEX_M4
    select SOC_FAMILY_STM32

menu "Hardware Drivers Config"

config SOC_STM32F407ZG
    bool
    select SOC_SERIES_STM32F4
    select RT_USING_COMPONENTS_INIT
    select RT_USING_USER_MAIN
    default y

menu "Onboard Peripheral Drivers"

	menuconfig BSP_USING_SRAM
        bool "Enable SRAM"
        default n
        if BSP_USING_SRAM
            config BSP_USING_EXT_FMC_IO
                    bool "SRAM used EXT_FMC_IO"
                    default n
            config BSP_USING_FMC
                    bool "SRAM used FMC"
                    default n
        endif

    config BSP_USING_ONBOARD_LCD
        bool "Enable LCD(ST7787)"
        select BSP_USING_SRAM
        select BSP_USING_EXT_FMC_IO
        select BSP_USING_FMC
        default n
        if BSP_USING_ONBOARD_LCD
            config BSP_USING_ONBOARD_LCD_PWM_BL
                bool "Enable pwm background light"
                default y
                select BSP_USING_PWM
                select BSP_USING_PWM14
                select BSP_USING_PWM14_CH1
        endif
    config PKG_USING_LVGL
            bool "Enable LVGL for LCD"
            select BSP_USING_ONBOARD_LCD
            default n
    if PKG_USING_LVGL
        config PKG_LVGL_USING_DEMOS
            bool "Enable LVGL demo"
            default n
        config PKG_LVGL_USING_EXAMPLES
            bool "Enable LVGL examples"
            default n
    endif

    menuconfig BSP_USING_FS
        bool "Enable File System"
        select RT_USING_DFS
        select RT_USING_DFS_ROMFS
        default n
        if BSP_USING_FS
            config BSP_USING_SDCARD_FATFS
                bool "Enable SDCARD (FATFS)"
                select BSP_USING_SDIO
                select RT_USING_DFS_ELMFAT
                default y
            if BSP_USING_SDCARD_FATFS
                menuconfig BSP_USING_FS_AUTO_MOUNT
                    bool "Enable filesystem auto mount"
                    default n
            endif
        endif

    menuconfig BSP_USING_AUDIO
        bool "Enable Audio Module"
        select RT_USING_AUDIO
        select BSP_USING_I2C
        select BSP_USING_I2C2
        default n
        if BSP_USING_AUDIO
            config BSP_USING_AUDIO_PLAY
            bool "Enable Audio Play"
            default y
            config BSP_USING_AUDIO_RECORD
            bool "Enable Audio Record"
            default n
        endif

    config BSP_USING_NES
        bool "Enable Nes Simulator"
        default n
endmenu

menu "On-chip Peripheral Drivers"

    config BSP_USING_GPIO
        bool "Enable GPIO"
        select RT_USING_PIN
        default y

    menuconfig BSP_USING_UART
        bool "Enable UART"
        default y
        select RT_USING_SERIAL
        if BSP_USING_UART
            config BSP_USING_UART1
                bool "Enable UART1"
                default y
            config BSP_UART1_RX_USING_DMA
                bool "Enable UART1 RX DMA"
                depends on BSP_USING_UART1 && RT_SERIAL_USING_DMA
                default n
			config BSP_UART1_TX_USING_DMA
                bool "Enable UART1 TX DMA"
                depends on BSP_USING_UART1 && RT_SERIAL_USING_DMA
                default n
        endif

    menuconfig BSP_USING_I2C
        bool "Enable I2C"
        default n
        if BSP_USING_I2C
            menuconfig BSP_USING_I2C1
                bool "Enable I2C1 BUS (software simulation)"
                default n
                select RT_USING_I2C
                select RT_USING_I2C_BITOPS
                select RT_USING_PIN
                if BSP_USING_I2C1
                    config BSP_I2C1_SCL_PIN
                        int "i2c1 scl pin number"
                        range 0 143
                        default 24
                    config BSP_I2C1_SDA_PIN
                        int "I2C1 sda pin number"
                        range 0 143
                        default 25
                endif

            menuconfig BSP_USING_I2C2
                bool "Enable I2C2 BUS for AP3216C/ICM20608/ES8388/ Onboard(software simulation)"
                default n
                select RT_USING_I2C
                select RT_USING_I2C_BITOPS
                select RT_USING_PIN
                if BSP_USING_I2C2
                    config BSP_I2C2_SCL_PIN
                        int "i2c2 scl pin number, PF1"
                        range 0 143
                        default 81
                    config BSP_I2C2_SDA_PIN
                        int "I2C2 sda pin number, PF0"
                        range 0 143
                        default 80
                endif

            menuconfig BSP_USING_I2C3
                bool "Enable I2C3 BUS for AHT21 Onboard(software simulation)"
                default n
                select RT_USING_I2C
                select RT_USING_I2C_BITOPS
                select RT_USING_PIN
                if BSP_USING_I2C3
                    config BSP_I2C3_SCL_PIN
                        int "i2c3 scl pin number, PE0"
                        range 0 143
                        default 64
                    config BSP_I2C3_SDA_PIN
                        int "I2C3 sda pin number, PE1"
                        range 0 143
                        default 65
                endif
        endif

	menuconfig BSP_USING_TIM
        bool "Enable timer"
        default n
        select RT_USING_HWTIMER
        if BSP_USING_TIM
            config BSP_USING_TIM11
                bool "Enable TIM11"
                default n

            config BSP_USING_TIM13
                bool "Enable TIM13"
                default n

            config BSP_USING_TIM14
                bool "Enable TIM14"
                default n
        endif
	
	menuconfig BSP_USING_PWM
        bool "Enable PWM"
        default n
        select RT_USING_PWM
        if BSP_USING_PWM
        menuconfig BSP_USING_PWM2
            bool "Enable timer2 output PWM"
            default n
            if BSP_USING_PWM2
                config BSP_USING_PWM2_CH4
                    bool "Enable PWM2 channel4"
                    default n
            endif
        menuconfig BSP_USING_PWM3
            bool "Enable timer3 output PWM"
            default n
            if BSP_USING_PWM3
                config BSP_USING_PWM3_CH2
                    bool "Enable PWM3 channel2"
                    default n
            endif
            if BSP_USING_PWM3
                config BSP_USING_PWM3_CH4
                    bool "Enable PWM3 channel4"
                    default n
            endif
        menuconfig BSP_USING_PWM14
            bool "Enable timer14 output PWM"
            default n
            if BSP_USING_PWM14
                config BSP_USING_PWM14_CH1
                    bool "Enable PWM14 channel1"
                    default n
            endif
        endif

	menuconfig BSP_USING_ONCHIP_RTC
            bool "Enable RTC"
            select RT_USING_RTC
            default n
            if BSP_USING_ONCHIP_RTC
                choice
                    prompt "Select clock source"
                    default BSP_RTC_USING_LSE

                    config BSP_RTC_USING_LSE
                        bool "RTC USING LSE"

                    config BSP_RTC_USING_LSI
                        bool "RTC USING LSI"
                endchoice
            endif

     config BSP_USING_SDIO
         bool "Enable SDIO"
         select RT_USING_SDIO
         select RT_USING_DFS
         default n
     config SDIO_MAX_FREQ
         int "sdio max freq"
         range 0 24000000
         depends on BSP_USING_SDIO
         default 1000000

    source "$RTT_DIR/../libraries/HAL_Drivers/Kconfig" 
    
endmenu

menu "Board extended module Drivers"

endmenu
 
endmenu
```

## offline_pkgs/Kconfig
```kconfig
menu "RT-Thread offline packages"

menuconfig OFFLINE_PKG_USING_MULTIBUTTON
	bool "Enable Multibutton package"
    default n
    if OFFLINE_PKG_USING_MULTIBUTTON
        config MULTIBUTTON_USING_EXAMPLE_CALLBACK
            bool "Enable async example"
            default n
        config MULTIBUTTON_USING_EXAMPLE_POLL
            bool "Enable inquire example"
            default n
    endif

# Kconfig file for package LVGL
menuconfig OFFLINE_PKG_USING_LVGL
    bool "LVGL (official): Light and Versatile Graphics Library"
    depends on RT_VER_NUM >= 0x40100
    default n

if OFFLINE_PKG_USING_LVGL

    config OFFLINE_PKG_LVGL_PATH
        string
        default "/packages/multimedia/LVGL/LVGL"

    config OFFLINE_PKG_LVGL_THREAD_PRIO
        int "Priority of LVGL thread"
        default 20

    config OFFLINE_PKG_LVGL_THREAD_STACK_SIZE
        int "Stack size of LVGL thread"
        default 4096

    config OFFLINE_PKG_LVGL_DISP_REFR_PERIOD
        int "Display refresh period (ms)"
        default 5 # official suggestion

    config OFFLINE_PKG_USING_LVGL_SQUARELINE
        bool "Support SquareLine Studio"
        default n

    config OFFLINE_PKG_LVGL_USING_EXAMPLES
        bool "Enable built-in examples"
        default n

    config OFFLINE_PKG_LVGL_USING_DEMOS
        bool "Enable built-in demos"
        default n

    choice
        prompt "Version"

        default OFFLINE_PKG_LVGL_USING_V08035
            bool "v8.3.5"
    endchoice

    config OFFLINE_PKG_LVGL_VER_NUM
        hex
        default 0x080305    if PKG_LVGL_USING_V08035

    config OFFLINE_PKG_LVGL_VER
       string
       default "v8.3.5"         if PKG_LVGL_VER_NUM = 0x080305

endif

endmenu
```
